## firmware/esp32_edge_impulse/main/Kconfig.projbuild
```kconfig
# Kconfig for ESP-MIAO main component

config ESP_MIAO_WIFI_SSID
    string "WiFi SSID"
    default "YOUR_SSID"
    help
        WiFi SSID to connect to.

config ESP_MIAO_WIFI_PASSWORD
    string "WiFi Password"
    default "YOUR_PASS"
    help
        WiFi Password to connect to.
```

## firmware/esp32_edge_impulse/sdkconfig.defaults
```kconfig
# ESP-MIAO Edge Impulse Wake Word - sdkconfig.defaults
# Target: ESP32 DevKit V1 + INMP441

# Target
CONFIG_IDF_TARGET="esp32"

# Flash
CONFIG_ESPTOOLPY_FLASHMODE_DIO=y
CONFIG_ESPTOOLPY_FLASHFREQ_80M=y
CONFIG_ESPTOOLPY_FLASHSIZE_4MB=y

# Partition: use large single app (Edge Impulse model needs space)
CONFIG_PARTITION_TABLE_SINGLE_APP_LARGE=y

# Compiler: optimize for performance (inference speed)
CONFIG_COMPILER_OPTIMIZATION_PERF=y

# FreeRTOS
CONFIG_FREERTOS_HZ=1000

# Watchdog: enable but increase timeout for long inference
CONFIG_ESP_TASK_WDT_EN=y
CONFIG_ESP_TASK_WDT_TIMEOUT_S=10
CONFIG_ESP_MIAO_WIFI_SSID="YOUR_SSID"
CONFIG_ESP_MIAO_WIFI_PASSWORD="YOUR_PASS"

# --- Arduino Configuration ---
CONFIG_AUTOSTART_ARDUINO=n
CONFIG_ARDUINO_RUNNING_CORE=1
CONFIG_ARDUINO_LOOP_STACK_SIZE=8192

# --- TFT_eSPI Configuration (ST7735 128x160) ---
CONFIG_TFT_eSPI_ESPIDF=y
CONFIG_TFT_ST7735_DRIVER=y
CONFIG_TFT_WIDTH=128
CONFIG_TFT_HEIGHT=160
CONFIG_TFT_ST7735_BLACKTAB=y
CONFIG_TFT_RGB_ORDER=y
CONFIG_TFT_INVERSION_DISABLE=y
CONFIG_TFT_SPI=y
CONFIG_TFT_VSPI_PORT=y
CONFIG_TFT_MOSI=23
CONFIG_TFT_SCLK=18
CONFIG_TFT_CS=16
CONFIG_TFT_DC=5
CONFIG_TFT_RST=17
CONFIG_ENABLE_BL=n
CONFIG_TFT_SPI_FREQUENCY=27000000
CONFIG_TFT_LOAD_GLCD=y
CONFIG_TFT_LOAD_FONT2=y
CONFIG_TFT_LOAD_FONT4=y
CONFIG_TFT_LOAD_FONT6=y
CONFIG_TFT_LOAD_FONT7=y
CONFIG_TFT_LOAD_FONT8=y
CONFIG_TFT_LOAD_GFXFF=y
CONFIG_TFT_SMOOTH_FONT=y
```
